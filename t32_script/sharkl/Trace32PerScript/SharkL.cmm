;This file is generated by Trace32PerBuilder Version: 0.5.3.
;  Please access external network Trace32 Per Builder Homepage for documents
;and source code.
;   http://wikiserver.spreadtrum.com/Projects/SoftwareSystem/wiki/BbDrvTools/Trace32PerBuilder

MENU.RP
(
ADD
MENU
(
  POPUP "SharkL"
  (
    menuitem "CP0-WCDMA DMA_LINK" "per ""C:\Documents and Settings\Administrator\桌面\Work\Tools\t32_script\sharkl\Trace32PerScript\Shark-L WCDMA DMA_LINK  Control Registe.per"" ""SharkL - CP0 Register"""
    menuitem "AON_TOP-aon_apb_rf" "per ""C:\Documents and Settings\Administrator\桌面\Work\Tools\t32_script\sharkl\Trace32PerScript\Shark-L AON APB Control Register.per"" ""SharkL - AON_TOP Register"""
    menuitem "AON_TOP-avs_apb_rf" "per ""C:\Documents and Settings\Administrator\桌面\Work\Tools\t32_script\sharkl\Trace32PerScript\Shark-L AON AVS Control Register.per"" ""SharkL - AON_TOP Register"""
    menuitem "AON_TOP-djtag_apb_rf" "per ""C:\Documents and Settings\Administrator\桌面\Work\Tools\t32_script\sharkl\Trace32PerScript\Shark-L AON DJTAG Control Register.per"" ""SharkL - AON_TOP Register"""
    menuitem "AP_TOP-ap_ahb_rf" "per ""C:\Documents and Settings\Administrator\桌面\Work\Tools\t32_script\sharkl\Trace32PerScript\Shark-L AP AHB Control Register.per"" ""SharkL - AP_TOP Register"""
    menuitem "AP_TOP-ap_apb" "per ""C:\Documents and Settings\Administrator\桌面\Work\Tools\t32_script\sharkl\Trace32PerScript\Shark-L AP APB Control Register.per"" ""SharkL - AP_TOP Register"""
    menuitem "ARM7-arm7_ahb_rf" "per ""C:\Documents and Settings\Administrator\桌面\Work\Tools\t32_script\sharkl\Trace32PerScript\Shark-L ARM7 AHB Control Register.per"" ""SharkL - ARM7 Register"""
    menuitem "Cortex_top-cortex_ahb_rf" "per ""C:\Documents and Settings\Administrator\桌面\Work\Tools\t32_script\sharkl\Trace32PerScript\Shark-L CA5 AHB Control Register.per"" ""SC9620 - Cortex_top Register"""
    menuitem "Cortex_top-cortex_glb" "per ""C:\Documents and Settings\Administrator\桌面\Work\Tools\t32_script\sharkl\Trace32PerScript\Shark-L CA5 APB Control Register.per"" ""SC9620 - Cortex_top Register"""
    menuitem "CP01-ada_apb_rf" "per ""C:\Documents and Settings\Administrator\桌面\Work\Tools\t32_script\sharkl\Trace32PerScript\Shark-L CP0 ADA Control Register.per"" ""Shark - CP01 Register"""
    menuitem "CP01-cp_ahb_rf" "per ""C:\Documents and Settings\Administrator\桌面\Work\Tools\t32_script\sharkl\Trace32PerScript\Shark-L CP0 AHB Control Register.per"" ""Tshark - CP01 Register"""
    menuitem "CP01-cp_apb_rf" "per ""C:\Documents and Settings\Administrator\桌面\Work\Tools\t32_script\sharkl\Trace32PerScript\Shark-L CP0 APB Control Register.per"" ""Tshark - CP01 Register"""
    menuitem "CP0-wcdma_ahb_rf" "per ""C:\Documents and Settings\Administrator\桌面\Work\Tools\t32_script\sharkl\Trace32PerScript\Shark-L CP0_WCDMA AHB Control Register.per"" ""Shark - CP0 Register"""
    menuitem "CP0-wcdma_apb_rf" "per ""C:\Documents and Settings\Administrator\桌面\Work\Tools\t32_script\sharkl\Trace32PerScript\Shark-L CP0_WCDMA APB Control Register.per"" ""Shark - CP0 Register"""
    menuitem "GPU_TOP-gpu_apb_rf" "per ""C:\Documents and Settings\Administrator\桌面\Work\Tools\t32_script\sharkl\Trace32PerScript\Shark-L GPU APB Control Register.per"" ""Shark - GPU_TOP Register"""
    menuitem "LTE_DSP-lte_cevax_pmu" "per ""C:\Documents and Settings\Administrator\桌面\Work\Tools\t32_script\sharkl\Trace32PerScript\Shark-L LDSP PMU Control Register.per"" ""SC9620 - LTE_DSP Register"""
    menuitem "aon-mdar_apb_rf" "per ""C:\Documents and Settings\Administrator\桌面\Work\Tools\t32_script\sharkl\Trace32PerScript\Shark-L MDAR Control Register.per"" ""SharkL - aon Register"""
    menuitem "MM_TOP-mm_ahb_rf" "per ""C:\Documents and Settings\Administrator\桌面\Work\Tools\t32_script\sharkl\Trace32PerScript\Shark-L MM AHB Control Register.per"" ""Tshark - MM_TOP Register"""
    menuitem "AON_TOP-pmu_apb_rf" "per ""C:\Documents and Settings\Administrator\桌面\Work\Tools\t32_script\sharkl\Trace32PerScript\Shark-L PMU APB Control Register.per"" ""SharkL - AON_TOP Register"""
    menuitem "PUB_TOP-pub_apb" "per ""C:\Documents and Settings\Administrator\桌面\Work\Tools\t32_script\sharkl\Trace32PerScript\Shark-L PUB APB Control Register.per"" ""Shark - PUB_TOP Register"""
  )
)
)
