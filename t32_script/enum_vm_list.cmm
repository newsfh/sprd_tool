        WINCLEAR INFOS  
        AREA.CREATE INFOS 80. 2000.
        WinPOS 0,0,,,,, INFOS  
        AREA.VIEW INFOS  
        AREA.CLEAR INFOS  
        AREA.SELECT INFOS  

;;;;;;;;;;;;;;;;;;;;;;;;;;;;;;;;;;;;;;;;;;;;;;;;;;;;;;;;;;;;;;;
; TRAVERSE_TASK		--  遍历所有task
; PrintTaskInfo		--  在遍历task过程，打印task里的信息
;;;;;;;;;;;;;;;;;;;;;;;;;;;;;;;;;;;;;;;;;;;;;;;;;;;;;;;;;;;;;;;

&LIST_OFFSET=v.value(&((struct vmap_area*)0)->list)

&i=0
GOSUB TRAVERSE_LIST
print "OK"
enddo

TRAVERSE_LIST:
	&list_head=v.value(&vmap_area_list)
	print &i "  " &list_head

	&list_cur=v.value(((struct list_head*)&list_head)->next)
	while &list_cur!=&list_head&&&list_cur!=0&&&list_cur!=0xffffffff
	(
		&i=&i+1.
		&start=v.value(((struct vmap_area*)(&list_cur-&LIST_OFFSET))->va_start)
		&end=v.value(((struct vmap_area*)(&list_cur-&LIST_OFFSET))->va_end)
		&flag=v.value(((struct vmap_area*)(&list_cur-&LIST_OFFSET))->flags)
		&vm=v.value(((struct vmap_area*)(&list_cur-&LIST_OFFSET))->vm)

		print &i "  " &list_cur ": start=" &start " end=" &end " flag=" &flag " vm=" &vm

		if &vm!=0
		(
			&vm_flag=v.value(((struct vmap_area*)(&list_cur-&LIST_OFFSET))->vm->flags)
			&page=v.value(((struct vmap_area*)(&list_cur-&LIST_OFFSET))->vm->pages)
			&page_count=v.value(((struct vmap_area*)(&list_cur-&LIST_OFFSET))->vm->nr_pages)
			&phy_add=v.value(((struct vmap_area*)(&list_cur-&LIST_OFFSET))->vm->phys_addr)

			print "          vm flags=" &vm_flag " page=" &page " page_nr=" &page_count " phy_addr=" &phy_add
		)

		&list_cur=v.value(((struct list_head*)&list_cur)->next)
	)

	print "====================="
	print &list_cur

	RETURN
; END TRAVERSE_TASK
