        WINCLEAR INFOS  
        AREA.CREATE INFOS 80. 2000.
        WinPOS 0,0,,,,, INFOS  
        AREA.VIEW INFOS  
        AREA.CLEAR INFOS  
        AREA.SELECT INFOS  

;;;;;;;;;;;;;;;;;;;;;;;;;;;;;;;;;;;;;;;;;;;;;;;;;;;;;;;;;;;;;;;
; TRAVERSE_TASK		--  遍历所有task
; PrintTaskInfo		--  在遍历task过程，打印task里的信息
;;;;;;;;;;;;;;;;;;;;;;;;;;;;;;;;;;;;;;;;;;;;;;;;;;;;;;;;;;;;;;;

&LIST_OFFSET=v.value(&((struct vmap_area*)0)->list)

&i=0
GOSUB TRAVERSE_LIST
print "OK"
enddo

TRAVERSE_LIST0:
	&list_head=v.value(vmlist)
	print &i "  " &list_head

	&list_cur=v.value(((struct vm_struct*)&list_head)->next)
	while &list_cur!=&list_head&&&list_cur!=0&&&list_cur!=0xffffffff
	(
		&i=&i+1.
		print &i "  " &list_cur

		&list_cur=v.value(((struct vm_struct*)&list_cur)->next)
	)

	print &list_cur

	RETURN
; END TRAVERSE_TASK

TRAVERSE_LIST:
	&add=0xD9744000
	while &i<375.
	(
		gosub print_sg &add
		&add=&add+0x10
		&i=&i+1.
	)
	return
; END TRAVERSE_TASK

print_sg:
	LOCAL &addr_tmp
	ENTRY &addr_tmp
	
	print &i "  " &addr_tmp "  " v.value(*((unsigned int*)&addr_tmp)) "  " v.value(*((unsigned int*)(&addr_tmp+0x4))) "  " v.value(*((unsigned int*)(&addr_tmp+0x8))) "  " v.value(*((unsigned int*)(&addr_tmp+0xc)))
	return
; end print_sg