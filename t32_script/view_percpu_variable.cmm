
v.v (struct rq*)((char*)&runqueues+__per_cpu_offset[0])