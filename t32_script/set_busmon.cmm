DATA.SET eahb:0x30020004 %LE %LONG 0x3ff0000

DATA.SET eahb:0x30040000 %LE %LONG 0x1
DATA.SET eahb:0x30040004 %LE %LONG 0x0
DATA.SET eahb:0x30040008 %LE %LONG 0xd0000000
DATA.SET eahb:0x3004000c %LE %LONG 0xdfffffff
DATA.SET eahb:0x30040010 %LE %LONG 0x0
DATA.SET eahb:0x30040014 %LE %LONG 0xffffffff
DATA.SET eahb:0x30040018 %LE %LONG 0x0000
DATA.SET eahb:0x3004001c %LE %LONG 0x0
DATA.SET eahb:0x30040020 %LE %LONG 0x0
DATA.SET eahb:0x30040024 %LE %LONG 0x0
DATA.SET eahb:0x30040028 %LE %LONG 0x0

DATA.SET eahb:0x30050000 %LE %LONG 0x1
DATA.SET eahb:0x30050004 %LE %LONG 0x0
DATA.SET eahb:0x30050008 %LE %LONG 0xd0000000
DATA.SET eahb:0x3005000c %LE %LONG 0xdfffffff
DATA.SET eahb:0x30050010 %LE %LONG 0x0
DATA.SET eahb:0x30050014 %LE %LONG 0xffffffff
DATA.SET eahb:0x30050018 %LE %LONG 0x0000
DATA.SET eahb:0x3005001c %LE %LONG 0x0
DATA.SET eahb:0x30050020 %LE %LONG 0x0
DATA.SET eahb:0x30050024 %LE %LONG 0x0
DATA.SET eahb:0x30050028 %LE %LONG 0x0

DATA.SET eahb:0x30060000 %LE %LONG 0x1
DATA.SET eahb:0x30060004 %LE %LONG 0x0
DATA.SET eahb:0x30060008 %LE %LONG 0xd0000000
DATA.SET eahb:0x3006000c %LE %LONG 0xdfffffff
DATA.SET eahb:0x30060010 %LE %LONG 0x0
DATA.SET eahb:0x30060014 %LE %LONG 0xffffffff
DATA.SET eahb:0x30060018 %LE %LONG 0x0000
DATA.SET eahb:0x3006001c %LE %LONG 0x0
DATA.SET eahb:0x30060020 %LE %LONG 0x0
DATA.SET eahb:0x30060024 %LE %LONG 0x0
DATA.SET eahb:0x30060028 %LE %LONG 0x0

DATA.SET eahb:0x30070000 %LE %LONG 0x1
DATA.SET eahb:0x30070004 %LE %LONG 0x0
DATA.SET eahb:0x30070008 %LE %LONG 0xd0000000
DATA.SET eahb:0x3007000c %LE %LONG 0xdfffffff
DATA.SET eahb:0x30070010 %LE %LONG 0x0
DATA.SET eahb:0x30070014 %LE %LONG 0xffffffff
DATA.SET eahb:0x30070018 %LE %LONG 0x0000
DATA.SET eahb:0x3007001c %LE %LONG 0x0
DATA.SET eahb:0x30070020 %LE %LONG 0x0
DATA.SET eahb:0x30070024 %LE %LONG 0x0
DATA.SET eahb:0x30070028 %LE %LONG 0x0

DATA.SET eahb:0x30080000 %LE %LONG 0x1
DATA.SET eahb:0x30080004 %LE %LONG 0x0
DATA.SET eahb:0x30080008 %LE %LONG 0xd0000000
DATA.SET eahb:0x3008000c %LE %LONG 0xdfffffff
DATA.SET eahb:0x30080010 %LE %LONG 0x0
DATA.SET eahb:0x30080014 %LE %LONG 0xffffffff
DATA.SET eahb:0x30080018 %LE %LONG 0x0000
DATA.SET eahb:0x3008001c %LE %LONG 0x0
DATA.SET eahb:0x30080020 %LE %LONG 0x0
DATA.SET eahb:0x30080024 %LE %LONG 0x0
DATA.SET eahb:0x30080028 %LE %LONG 0x0

DATA.SET eahb:0x30090000 %LE %LONG 0x1
DATA.SET eahb:0x30090004 %LE %LONG 0x0
DATA.SET eahb:0x30090008 %LE %LONG 0xd0000000
DATA.SET eahb:0x3009000c %LE %LONG 0xdfffffff
DATA.SET eahb:0x30090010 %LE %LONG 0x0
DATA.SET eahb:0x30090014 %LE %LONG 0xffffffff
DATA.SET eahb:0x30090018 %LE %LONG 0x0000
DATA.SET eahb:0x3009001c %LE %LONG 0x0
DATA.SET eahb:0x30090020 %LE %LONG 0x0
DATA.SET eahb:0x30090024 %LE %LONG 0x0
DATA.SET eahb:0x30090028 %LE %LONG 0x0

DATA.SET eahb:0x300b0000 %LE %LONG 0x1
DATA.SET eahb:0x300b0004 %LE %LONG 0x0
DATA.SET eahb:0x300b0008 %LE %LONG 0xd0000000
DATA.SET eahb:0x300b000c %LE %LONG 0xdfffffff
DATA.SET eahb:0x300b0010 %LE %LONG 0x0
DATA.SET eahb:0x300b0014 %LE %LONG 0xffffffff
DATA.SET eahb:0x300b0018 %LE %LONG 0x0000
DATA.SET eahb:0x300b001c %LE %LONG 0x0
DATA.SET eahb:0x300b0020 %LE %LONG 0x0
DATA.SET eahb:0x300b0024 %LE %LONG 0x0
DATA.SET eahb:0x300b0028 %LE %LONG 0x0

DATA.SET eahb:0x300c0000 %LE %LONG 0x1
DATA.SET eahb:0x300c0004 %LE %LONG 0x0
DATA.SET eahb:0x300c0008 %LE %LONG 0xd0000000
DATA.SET eahb:0x300c000c %LE %LONG 0xdfffffff
DATA.SET eahb:0x300c0010 %LE %LONG 0x0
DATA.SET eahb:0x300c0014 %LE %LONG 0xffffffff
DATA.SET eahb:0x300c0018 %LE %LONG 0x0000
DATA.SET eahb:0x300c001c %LE %LONG 0x0
DATA.SET eahb:0x300c0020 %LE %LONG 0x0
DATA.SET eahb:0x300c0024 %LE %LONG 0x0
DATA.SET eahb:0x300c0028 %LE %LONG 0x0

DATA.SET eahb:0x300d0000 %LE %LONG 0x1
DATA.SET eahb:0x300d0004 %LE %LONG 0x0
DATA.SET eahb:0x300d0008 %LE %LONG 0xd0000000
DATA.SET eahb:0x300d000c %LE %LONG 0xdfffffff
DATA.SET eahb:0x300d0010 %LE %LONG 0x0
DATA.SET eahb:0x300d0014 %LE %LONG 0xffffffff
DATA.SET eahb:0x300d0018 %LE %LONG 0x0000
DATA.SET eahb:0x300d001c %LE %LONG 0x0
DATA.SET eahb:0x300d0020 %LE %LONG 0x0
DATA.SET eahb:0x300d0024 %LE %LONG 0x0
DATA.SET eahb:0x300d0028 %LE %LONG 0x0

