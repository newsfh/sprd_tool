        WINCLEAR INFOS  
        AREA.CREATE INFOS 80. 2000.
        WinPOS 0,0,,,,, INFOS  
        AREA.VIEW INFOS  
        AREA.CLEAR INFOS  
        AREA.SELECT INFOS  


&pgd=0xD7D84000
&virtual_addr=0x74a03000

&first_pg_inx=((&virtual_addr>>20.)*4)
&first_pg_val=data.long(D:&pgd+&first_pg_inx)

if v.value(&first_pg_val&0x3)==0x2
(
	&phy_add=v.value((&first_pg_val&0xfff00000)+(&virtual_addr&0xfffff))

	print &virtual_addr " => " &phy_add
	print "info:"
	print "pgd=&pgd , first_pg_inx=&first_pg_inx , first_pg_val=&first_pg_val"
)
else if v.value(&first_pg_val&0x3)==0x1
(
	&sec_pgd=v.value((&first_pg_val&0xfffff000)+0x40000000)
	&sec_pg_inx=v.value(((&virtual_addr>>12.)&0xff)*4)
	&sec_pg_val=data.long(D:&sec_pgd+&sec_pg_inx)
	&phy_add=v.value((&sec_pg_val&0xfffff000)+(&virtual_addr&0xfff))

	print &virtual_addr " => " &phy_add
	print "info:"
	print "pgd=&pgd , first_pg_inx=&first_pg_inx , first_pg_val=&first_pg_val"
	print "sec_pgd=&sec_pgd , sec_pg_inx=&sec_pg_inx , sec_pg_val=&sec_pg_val"
)
else if v.value(&first_pg_val&0x3)==0x3
(
	&sec_pgd=v.value((&first_pg_val&0xfffffc00)+0x40000000)
	&sec_pg_inx=v.value(((&virtual_addr>>10.)&0x3ff)*4)
	&sec_pg_val=data.long(D:&sec_pgd+&sec_pg_inx)
	&phy_add=v.value((&sec_pg_val&0xfffffc00)+(&virtual_addr&0x3ff))

	print &virtual_addr " => " &phy_add
	print "info:"
	print "pgd=&pgd , first_pg_inx=&first_pg_inx , first_pg_val=&first_pg_val"
	print "sec_pgd=&sec_pgd , sec_pg_inx=&sec_pg_inx , sec_pg_val=&sec_pg_val"
)
else
(
	print "invalid virtual address"
)

print "OK"
enddo

