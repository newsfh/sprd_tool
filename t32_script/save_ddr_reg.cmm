d.save.binary c:\0x30000000 eahb:0x30000000++0x800
d.save.binary c:\0x30010000 eahb:0x30010000++0x800
d.save.binary c:\0x30020000 eahb:0x30020000++0x2000

