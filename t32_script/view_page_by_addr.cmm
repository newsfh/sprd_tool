;; view page struct by memory address

GOSUB ADDR_TO_PAGE 0xC69FFE00

enddo

ADDR_TO_PAGE:
	LOCAL &addr_ptr
	ENTRY &addr_ptr

	&MEM_MAP_ADDR=v.value(mem_map)
	&PAGE_SIZE=v.value(sizeof(struct page))

	v.v %HEX %string (struct page*)(&MEM_MAP_ADDR+((&addr_ptr-0xc0000000)>>12.)*&PAGE_SIZE)

	RETURN
; END ADDR_TO_PAGE
