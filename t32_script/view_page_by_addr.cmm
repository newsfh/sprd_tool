;; view page struct by memory address

&base_address=0xc0000000
GOSUB ADDR_TO_PAGE 0xe4f28700

enddo

ADDR_TO_PAGE:
	LOCAL &addr_ptr
	ENTRY &addr_ptr

	&MEM_MAP_ADDR=v.value(mem_map)
	&PAGE_SIZE=v.value(sizeof(struct page))

	v.v %HEX %string (struct page*)(&MEM_MAP_ADDR+((&addr_ptr-&base_address)>>12.)*&PAGE_SIZE)

	RETURN
; END ADDR_TO_PAGE
