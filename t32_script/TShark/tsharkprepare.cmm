;system.reset
system.jtagclock 10mhz

system.cpu CORTEXA7MPCORE
system.config CORENUMBER 4
core.assign 1 2 3 4

system.config FUNNELBASE 0x80001000
system.config ETBBASE 0x80003000
system.config TPIUBASE 0x80004000

system.config corebase 0x80030000 0x80032000 0x80034000 0x80036000
system.config CTIBASE 0x80038000 0x80039000 0x8003A000 0x8003B000
system.config ETMBASE 0x8003c000 0x8003D000 0x8003E000 0x8003F000

tronchip.set.dabort.off
tronchip.set.pabort.off
tronchip.set.undef.off
tronchip.set.reset.off

system.cpuaccess enable

system.mode prepare

task.config C:\T32\demo\arm\kernel\linux\linux.t32
menu.REPROGRAM C:\T32\demo\arm\kernel\linux\linux.men
